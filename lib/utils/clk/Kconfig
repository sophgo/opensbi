## lib/utils/clk/Kconfig
```kconfig
# SPDX-License-Identifier: BSD-2-Clause

menu "Clock Support"

config FDT_CLK
	bool "FDT based CLK drivers"
	depends on FDT
	default n

if FDT_CLK

config FDT_CLK_SG2044
	bool "SG2044 clock drivers"
	default n

endif

endmenu
```

## lib/utils/cppc/Kconfig
```kconfig
# SPDX-License-Identifier: BSD-2-Clause

menu "CPPC Device Support"

config FDT_CPPC
	bool "FDT based CPPC drivers"
	depends on FDT
	default n

if FDT_CPPC

config FDT_CPPC_RPMI
	bool "FDT RPMI CPPC driver"
	depends on FDT_MAILBOX && RPMI_MAILBOX
	default n

config FDT_CPPC_SG2044
	bool "FDT SG2044 CPPC driver"
	select FDT_CLK_SG2044
	default n

endif

endmenu
```

## lib/utils/timer/Kconfig
```kconfig
# SPDX-License-Identifier: BSD-2-Clause

menu "Timer Device Support"

config FDT_TIMER
	bool "FDT based timer drivers"
	depends on FDT
	default n

if FDT_TIMER

config FDT_TIMER_MTIMER
	bool "ACLINT MTIMER FDT driver"
	select TIMER_MTIMER
	default n

config FDT_TIMER_PLMT
	bool "Andes PLMT FDT driver"
	select TIMER_PLMT
	default n

config FDT_TIMER_SG2042_GMT
	bool "SOPHGO SG2042 global mtimer FDT driver"
	select TIMER_SG2042_GMT
	default n

endif

config TIMER_MTIMER
	bool "ACLINT MTIMER support"
	default n

config TIMER_PLMT
	bool "Andes PLMT support"
	default n

config TIMER_SG2042_GMT
	bool "SOPHGO SG2042 GMT support"
	default n

endmenu
```
